## configs/sun60iw2_minimal_defconfig
```kconfig
# Minimal defconfig for Orange Pi 4 Pro UART bringup
# This is the smallest config that can boot to a shell prompt

CONFIG_ARCH_SUNXI=y
CONFIG_ARCH_SUN60IW2=y
CONFIG_64BIT=y
CONFIG_ARM64=y

# CPU
CONFIG_SMP=y
CONFIG_NR_CPUS=8
CONFIG_ARM_PSCI=y

# Serial - CRITICAL for bringup
CONFIG_SERIAL_8250=y
CONFIG_SERIAL_8250_CONSOLE=y
CONFIG_SERIAL_8250_DW=y
CONFIG_SERIAL_OF_PLATFORM=y

# Clocks
CONFIG_COMMON_CLK=y
CONFIG_SUNXI_CCU=y
CONFIG_SUN60I_A733_CCU=y

# Pinctrl
CONFIG_PINCTRL=y
CONFIG_PINCTRL_SUNXI=y
CONFIG_PINCTRL_SUN60I_A733=y

# Timer
CONFIG_TIMER_OF=y

# Basic kernel features
CONFIG_BLOCK=y
CONFIG_BLK_DEV=y
CONFIG_BLK_DEV_INITRD=y
CONFIG_RD_GZIP=y

# Filesystems for initrd
CONFIG_PROC_FS=y
CONFIG_SYSFS=y
CONFIG_TMPFS=y
CONFIG_DEVTMPFS=y
CONFIG_DEVTMPFS_MOUNT=y

# Debug
CONFIG_PRINTK=y
CONFIG_EARLY_PRINTK=y
CONFIG_DEBUG_LL=y
CONFIG_PRINTK_TIME=y
```

## generators/output/Kconfig.sun60iw2
```kconfig
# sun60iw2 SoC family configuration
# Include this in drivers/soc/sunxi/Kconfig or create arch/arm64/Kconfig.platforms entry

menuconfig ARCH_SUN60IW2
	bool "Allwinner sun60iw2 (A733) SoC Family"
	depends on ARCH_SUNXI
	default n
	help
	  Support for Allwinner sun60iw2 SoC family (A733 and variants).
	  This includes the Orange Pi 4 Pro and other boards based on
	  the A733 SoC.

if ARCH_SUN60IW2

config SUN60I_A733_CCU
	bool "Allwinner A733 Clock Controller"
	default y
	help
	  Support for the Clock Controller Unit (CCU) on Allwinner A733.

config SUN60I_A733_PINCTRL
	bool "Allwinner A733 Pin Controller"
	default y
	help
	  Support for the pin controller on Allwinner A733.

config SUN60I_A733_WATCHDOG
	bool "Allwinner A733 Watchdog"
	default y
	help
	  Support for the watchdog timer on Allwinner A733.

endif # ARCH_SUN60IW2
```
